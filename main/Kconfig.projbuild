## main/Kconfig.projbuild
```kconfig
menu "Configuración FDR"

    choice FDR_DEVICE_ROLE
        prompt "Rol del dispositivo"
        default FDR_ROLE_MASTER
        help
            Selecciona el rol del dispositivo en el sistema FDR.

        config FDR_ROLE_MASTER
            bool "Maestro (Almacenamiento & Comunicación)"
            help
                El maestro maneja el almacenamiento (SD/eMMC), GNSS y comunicación externa.
        
        config FDR_ROLE_SLAVE
            bool "Esclavo (Adquisición)"
            help
                El esclavo maneja la adquisición de sensores (ADC, GPIO) y transmisión de datos al maestro.
    endchoice

    menu "Configuración SPI"
        config FDR_SPI_HOST_ID
            int "SPI Host ID"
            default 2
            help
                SPI2_HOST (FSPI) o SPI3_HOST (HSPI).
    endmenu

endmenu
```
